## camera_framework/examples/take_photo_to_screen/project/Kconfig.proj
```kconfig
config CUSTOM_MEM_MAP
    bool
	select custom_mem_map
	default y if !SOC_SIMULATOR

rsource "../../../Kconfig"

menu "Camera DVP pads"

	depends on CAMERA_DVP_BACKEND_DCMI

	config CAMERA_DVP_VSYNC_PIN
		int "VSYNC pad (PAx index, -1 = do not mux)"
		default 37

	config CAMERA_DVP_HSYNC_PIN
		int "HSYNC pad (PAx index, -1 = do not mux)"
		default 38

	config CAMERA_DVP_PCLK_PIN
		int "PCLK pad (PAx index, -1 = do not mux)"
		default 40

	config CAMERA_DVP_D0_PIN
		int "D0 pad (PAx index, -1 = do not mux)"
		default 41

	config CAMERA_DVP_D1_PIN
		int "D1 pad (PAx index, -1 = do not mux)"
		default 43

	config CAMERA_DVP_D2_PIN
		int "D2 pad (PAx index, -1 = do not mux)"
		default 44

	config CAMERA_DVP_D3_PIN
		int "D3 pad (PAx index, -1 = do not mux)"
		default 42

	config CAMERA_DVP_D4_PIN
		int "D4 pad (PAx index, -1 = do not mux)"
		default 48

	config CAMERA_DVP_D5_PIN
		int "D5 pad (PAx index, -1 = do not mux)"
		default 47

	config CAMERA_DVP_D6_PIN
		int "D6 pad (PAx index, -1 = do not mux)"
		default 46

	config CAMERA_DVP_D7_PIN
		int "D7 pad (PAx index, -1 = do not mux)"
		default 45
endmenu

menu "Camera 2-bit SPI pads"

	depends on CAMERA_SERIAL_SPI_2BIT

	config CAMERA_SERIAL_CLK_PIN
		int "Serial clock pad (PAx index, -1 = do not mux)"
		default 40

	config CAMERA_SERIAL_D0_PIN
		int "Serial D0 pad (PAx index, -1 = do not mux)"
		default 41

	config CAMERA_SERIAL_D1_PIN
		int "Serial D1 pad (PAx index, -1 = do not mux)"
		default 43
endmenu
```

## camera_framework/software/isp/Kconfig
```kconfig
menu "Camera software ISP"

choice
    prompt "ISP pipeline"
    default CAMERA_ISP_SOFTWARE if CAMERA_SW_ISP_EXAMPLE_HCPU
    default CAMERA_ISP_SOFTWARE if CAMERA_SW_ACPU_EXAMPLE
    default CAMERA_ISP_SOFTWARE if SENSOR_USING_GC032A
    default CAMERA_ISP_HARDWARE if CAMERA_USING_ARDUCAM_FIFO

config CAMERA_ISP_HARDWARE
    bool "Sensor hardware ISP only"
    depends on !CAMERA_SW_ACPU_EXAMPLE

config CAMERA_ISP_SOFTWARE
    bool "Software ISP"
endchoice

config CAMERA_SW_ISP
    bool
    default y if CAMERA_ISP_SOFTWARE

if CAMERA_ISP_SOFTWARE

choice
    prompt "Camera software ISP execution core"
    default CAMERA_SW_ISP_RUN_ON_HCPU if CAMERA_SW_ISP_EXAMPLE_HCPU
    default CAMERA_SW_ISP_RUN_ON_ACPU if BSP_USING_ACPU
    default CAMERA_SW_ISP_RUN_ON_HCPU

config CAMERA_SW_ISP_RUN_ON_HCPU
    bool "HCPU"
    depends on !CAMERA_SW_ACPU_EXAMPLE

config CAMERA_SW_ISP_RUN_ON_ACPU
    bool "ACPU"
    depends on BSP_USING_ACPU

endchoice

config CAMERA_SW_ISP_GAMMA
    bool "Base gamma correction"
    default y
    help
      GC032A FLAT baseline: fixes mid-tone readability of the demosaiced
      RGB565 input. Keep this enabled while the other software ISP stages are
      still experimental on GC032A.

config CAMERA_SW_ISP_AWB
    bool "Software AWB"
    help
      [实验性/GC032A 待校准] Software AWB statistics and neutral-candidate
      gray-world gains. Do not treat current GC032A output as calibrated until
      indoor/outdoor same-input shooting passes.

config CAMERA_SW_ISP_TONE
    bool "Software tone mapping"
    help
      [实验性/GC032A 待校准] Global percentile tone LUT with fixed blend.
      Parameters still require indoor/outdoor re-shooting on GC032A.

config CAMERA_SW_ISP_VIVID
    bool "Software vivid enhancement"
    help
      [实验性/GC032A 待校准] Mild-saturation CCM profile. Saturation matrix
      still requires GC032A calibration confirmation.

config CAMERA_SW_ISP_DITHER
    bool "4x4 ordered RGB565 dithering"
    default y
    help
      Applies deterministic 4x4 Bayer ordered dithering before final RGB565
      quantization. It improves transformed gradients only; it cannot recover
      color precision already lost by the sensor's RGB565 output.

config CAMERA_ISP_COMPARE_DEBUG
    bool "Temporary JPEG ISP comparison debug"

config CAMERA_CONTINUOUS_PERF_LOG
    bool "Continuously print preview performance"

endif
endmenu
```
