## camera/bf30a2/Kconfig
```kconfig
menuconfig PKG_USING_BF30A2
    bool "Enable BF30A2 SPI Camera Driver Package"
    select BSP_USING_I2C
    select BSP_USING_I2C2
    select BSP_USING_PWM
    select BSP_USING_PWM2
    default y
    help
        BF30A2 SPI camera driver with RT-Thread standard device interface.
        Supports image capture, YUV to RGB conversion, and DMA transfer.

if PKG_USING_BF30A2

    menu "Driver Configuration"

        config BF30A2_DEVICE_NAME
            string "Device name"
            default "bf30a2"
            help
                RT-Thread device name for the BF30A2 camera.

        config BF30A2_AUTO_REGISTER
            bool "Auto register device on boot"
            default y
            help
                Automatically register BF30A2 device during system initialization.

        menu "Hardware Configuration"

            config BF30A2_SPI_BUS
                string "SPI bus name"
                default "spi2"
                help
                    Name of the SPI bus device to use.

            config BF30A2_SPI_DEVICE
                string "SPI device name"
                default "camera"
                help
                    Name for the SPI device attachment.

            config BF30A2_I2C_BUS
                string "I2C bus name for camera control"
                default "i2c2"
                help
                    I2C bus used for camera register configuration.

            config BF30A2_I2C_ADDR
                hex "I2C slave address"
                default 0x6E
                help
                    7-bit I2C address of the BF30A2 camera.

            config BF30A2_PWM_DEV
                string "PWM device name for MCLK"
                default "pwm2"
                help
                    PWM device used to generate master clock for camera.

            config BF30A2_PWM_CHANNEL
                int "PWM channel"
                range 1 4
                default 2
                help
                    PWM channel number for MCLK output.

        endmenu

        menu "Pin Configuration"

            comment "Pin numbers are PA offset (e.g., 39 means PA39)"

            config BF30A2_SPI_CLK_PAD
                int "SPI CLK pad (PA offset)"
                range 0 63
                default 39
                help
                    GPIO pin for SPI clock signal.

            config BF30A2_SPI_DIO_PAD
                int "SPI DIO pad (PA offset)"
                range 0 63
                default 37
                help
                    GPIO pin for SPI data IO (MOSI/MISO).

            config BF30A2_SPI_CS_PAD
                int "SPI CS pad (PA offset)"
                range 0 63
                default 40
                help
                    GPIO pin for SPI chip select.

            config BF30A2_I2C_SCL_PAD
                int "I2C SCL pad (PA offset)"
                range 0 63
                default 41
                help
                    GPIO pin for I2C clock.

            config BF30A2_I2C_SDA_PAD
                int "I2C SDA pad (PA offset)"
                range 0 63
                default 42
                help
                    GPIO pin for I2C data.

            config BF30A2_PWM_PAD
                int "PWM MCLK pad (PA offset)"
                range 0 63
                default 20
                help
                    GPIO pin for PWM output (camera MCLK).

            config BF30A2_PWDN_PIN
                int "Power down GPIO pin (PA offset)"
                range 0 63
                default 43
                help
                    GPIO pin for camera power down control.

        endmenu

    endmenu

endif # PKG_USING_BF30A2
```

## camera/ov2640/Kconfig
```kconfig
menu "ov2640 camera"

    config SENSOR_USING_OV2640
        bool "Enable OV2640 Camera Module"
        default y
        help
          Enable this option to use OV2640 as the camera sensor module.
		  
    menu "DVP configuration"
        depends on SENSOR_USING_OV2640

      config OV2640_DVP_PINGPONG_BUFFER_SIZE
            int "DVP PingPong Buffer Size"
            default 8192
            range 1024 65536
            help
              Specify the size of the ping-pong buffer used for DVP data capture from the OV2640 camera module.

        config OV2640_DVP_DATA_PIN_BASE
            int "DVP Data Pin Base Numbers"
            default 0
            help
              DO NOT MODIFY! Only for internal use to specify the base pin number for DVP data pins (D0-D7) of the OV2640 camera module.
        config OV2640_DVP_VSYNC_PIN
            int "DVP VSYNC Pin Number"
            default 42
            help
              Specify the pin number connected to the DVP VSYNC signal of the OV2640 camera module.
              This pin is used for GPIO interrupt.

    endmenu

    menu "SCCB configuration"
        depends on SENSOR_USING_OV2640

        config OV2640_SCCB_I2C_BUS_NAME
            string "SCCB I2C Bus Name"
            default "i2c1"
            help
              Specify the I2C bus name used for SCCB communication with the OV2640 camera module.

        config OV2640_SCCB_TIMEOUT_MS
            int "SCCB Timeout (ms)"
            default 1000
            help
              Specify the timeout value in milliseconds for SCCB I2C communication.

        config OV2640_SCCB_MAX_HZ
            int "SCCB I2C Max Frequency (Hz)"
            default 100000
            range 10000 400000
            help
              Specify the maximum I2C bus frequency in Hz for SCCB communication.
              Default is 100kHz (100000 Hz).

    endmenu

    menu "Camera configuration"
        depends on SENSOR_USING_OV2640

        config OV2640_CAMERA_READ_TIMEOUT_MS
            int "Camera Read Timeout (ms)"
            default 1000
            range 100 10000
            help
              Specify the timeout value in milliseconds for camera read operations.
              Default is 1000ms (1 second).

        config OV2640_DVP_XCLK_PIN
            int "XCLK Output Pin Number"
            default -1
            help
              Specify the pin number for XCLK (external clock) output.
              Set to -1 to disable XCLK output (use external clock source).
              NOTE: User must configure this pin as GPTIM2_CH1 in main.c before opening the camera device.
              Example: HAL_PIN_Set(PAD_PA00 + 44, GPTIM2_CH1, PIN_NOPULL, 1);

        choice
            prompt "XCLK Output Frequency"
            default OV2640_DVP_XCLK_FREQ_12M
            depends on OV2640_DVP_XCLK_PIN != -1
            help
              Select the XCLK output frequency for the OV2640 camera module.
              GPTIM2 runs at 24MHz, so only 6MHz and 12MHz can be generated.

            config OV2640_DVP_XCLK_FREQ_6M
                bool "6 MHz"
                help
                  Generate 6MHz XCLK (24MHz / 4).

            config OV2640_DVP_XCLK_FREQ_12M
                bool "12 MHz"
                help
                  Generate 12MHz XCLK (24MHz / 2).
        endchoice

        config OV2640_DVP_XCLK_FREQ
            int
            default 6000000 if OV2640_DVP_XCLK_FREQ_6M
            default 12000000 if OV2640_DVP_XCLK_FREQ_12M
            default 0

    endmenu

endmenu
```
